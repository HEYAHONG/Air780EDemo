## Kconfig
```kconfig
mainmenu "Air780E"


config APP_NAME
    string "App Name"
    default "Air780EDemo"
```

## app/Kconfig
```kconfig
menu "log"

config UART_APP_DEBUG
    bool "uart app debug(uart0)"
    default y

endmenu

menu "watchdog"

config WATCHDOG_TIMEOUT
    int "watchdog timeout(s)"
    default 60
    range 20 60

endmenu

menu "mobile"

config MOBILE_WATCHDOG_TIMEOUT
    int "mobile watchdog timeout(s)"
    default 120
    range 30 6000000 

config MOBILE_INTERNET_DETECT
    bool "mobile internet detect"
    default y

if  MOBILE_INTERNET_DETECT

config MOBILE_INTERNET_DETECT_URL
    string "mobile internet detect url(only support http)"
    default "http://example.com/index.html"

endif

endmenu

menu "MQTT"

config MQTT_WATCHDOG_TIMEOUT
    int "mqtt watchdog timeout(s)"
    default 300
    range 30 6000000


choice MQTT_STACK
    bool "Choose MQTT Stack"
    default  MQTT_STACK_HELLO

config MQTT_STACK_HELLO
    bool "Hello"

endchoice

if MQTT_STACK_HELLO

config MQTT_STACK_HELLO_HOST
    string "hostname"
    default "lbsmqtt.airm2m.com"

config MQTT_STACK_HELLO_PORT
    int "port"
    default 1884


config MQTT_STACK_HELLO_SSL
    bool "SSL"
    default n

endif

endmenu
```
